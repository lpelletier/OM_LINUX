## linux-2.6.29.6/arch/arm/mach-imx/Kconfig
```kconfig
menu "IMX Implementations"
	depends on ARCH_IMX

choice
    prompt "Development board selection"
    depends on ARCH_IMX

config ARCH_MX1ADS
	bool "mx1ads"
	depends on ARCH_IMX
	select ISA
	help
	  Say Y here if you are using the Motorola MX1ADS board

config MACH_APF9328
	bool "APF9328"
	depends on ARCH_IMX
	help
	  Say Yes here if you are using the Armadeus APF9328 development board

endchoice

choice
       prompt "Flash available on board"
       depends on MACH_APF9328
       default IMX_APF9328_FLASH_16MB

config IMX_APF9328_FLASH_8MB
       bool "8MB"

config IMX_APF9328_FLASH_16MB
       bool "16MB"

endchoice

choice
        prompt "Baseboard"
        depends on MACH_APF9328
        default MACH_APF9328_DEV

config MACH_APF9328_DEV
        prompt "DevLight/DevFull"
        bool
        help
          This selects the APF9328_DevLight/DevFull as baseboard. You have
	  to manually activates the devices you want to use if you have a
	  DevFull.

endchoice

endmenu
```

## linux-2.6.29.6/drivers/mxc/Kconfig
```kconfig
# drivers/video/mxc/Kconfig

if ARCH_MXC

menu "MXC support drivers"

#if MACH_MX27
source "drivers/mxc/vpu/Kconfig"
#endif

endmenu

endif
```

## linux-2.6.29.6/drivers/video/mxc/Kconfig
```kconfig
config FB_MXC_SYNC_PANEL
	depends on FB_MXC
	tristate "Synchronous Panel Framebuffer"
	default y
	help
	  FIXME

#config FB_MXC_TVOUT
#	tristate "TV Out Encoder"
#	depends on FB_MXC_SYNC_PANEL
#	default n
#	help
#	  FIXME

config FB_MXC_OVERLAY
	bool "Framebuffer Overlay Plane"
	depends on FB_MXC_SYNC_PANEL
	default n
	help
	  FIXME

#config FB_MXC_ASYNC_PANEL
#	depends on FB_MXC
#	bool "Asynchronous Panels"
#	default n
#	help
#	  FIXME
#
#menu "Asynchronous Panel Type"
#	depends on FB_MXC_ASYNC_PANEL && FB_MXC
#
#config FB_MXC_EPSON_PANEL
#	depends on FB_MXC_ASYNC_PANEL
#	default n
#	bool "Epson 176x220 Panel"
#	help
#	  FIXME
#
#endmenu
#
#choice
#	prompt "Async Panel Interface Type"
#	depends on FB_MXC_ASYNC_PANEL && FB_MXC
#	default FB_MXC_ASYNC_PANEL_IFC_16_BIT
#
#config FB_MXC_ASYNC_PANEL_IFC_8_BIT
#	bool "8-bit Parallel Bus Interface"
#	help
#	  FIXME
#
#config FB_MXC_ASYNC_PANEL_IFC_16_BIT
#	bool "16-bit Parallel Bus Interface"
#	help
#	  FIXME
#
#config FB_MXC_ASYNC_PANEL_IFC_SERIAL
#	bool "Serial Bus Interface"
#	help
#	  FIXME
#
#endchoice
```

## linux-2.6.29.6/sound/arm/Kconfig
```kconfig
# ALSA ARM drivers

menuconfig SND_ARM
	bool "ARM sound devices"
	depends on ARM
	default y
	help
	  Support for sound devices specific to ARM architectures.
	  Drivers that are implemented on ASoC can be found in
	  "ALSA for SoC audio support" section.

if SND_ARM

config SND_SA11XX_UDA1341
	tristate "SA11xx UDA1341TS driver (iPaq H3600)"
	depends on ARCH_SA1100 && L3
	select SND_PCM
	help
	  Say Y here if you have a Compaq iPaq H3x00 handheld computer
	  and want to use its Philips UDA 1341 audio chip.

	  To compile this driver as a module, choose M here: the module
	  will be called snd-sa11xx-uda1341.

config SND_ARMAACI
	tristate "ARM PrimeCell PL041 AC Link support"
	depends on ARM_AMBA
	select SND_PCM
	select SND_AC97_CODEC

config SND_IMX_PCM
        tristate "i.MX1/L SSI driver"
        depends on SND && ARCH_IMX
        select SND_PCM
        help
          Say Y here to include support for i.MX1/L based CPU cards with
          sound output.

          To compile this driver as a module, choose M here: the module
          will be called snd-imx.

config SND_IMX2_PCM
	tristate "i.MX27 SSI driver"
	depends on SND && ARCH_MX2
	select SND_PCM
	help
	  Say Y here to include support for i.MX27 based CPU cards with
	  sound output based on the external MC13783 chip (aka PMIC).

	  To compile this driver as a module, choose M here: the module
	  will be called snd-mc13783.

config SND_PXA2XX_PCM
	tristate
	select SND_PCM

config SND_PXA2XX_LIB
	tristate
	select SND_AC97_CODEC if SND_PXA2XX_LIB_AC97

config SND_PXA2XX_LIB_AC97
	bool

config SND_PXA2XX_AC97
	tristate "AC97 driver for the Intel PXA2xx chip"
	depends on ARCH_PXA
	select SND_PXA2XX_PCM
	select SND_AC97_CODEC
	select SND_PXA2XX_LIB
	select SND_PXA2XX_LIB_AC97
	help
	  Say Y or M if you want to support any AC97 codec attached to
	  the PXA2xx AC97 interface.

config SND_IMX_TSC2102
	tristate "TSC210x alsa driver"
 	depends on (SND_IMX_PCM || SND_IMX2_PCM)
 	select SND_PCM
	select SPI_TSC2102
 	help
 	  Say Y here if you have an i.MX platform board
 	  and a TSC210x audio chip.

 	  To compile this driver as a module, choose M here: the module
 	  will be called snd-imx-tsc210x.

endif	# SND_ARM
```
